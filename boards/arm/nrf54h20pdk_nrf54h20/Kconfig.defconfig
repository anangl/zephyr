## soc/arm/nordic_nrf/nrf54h/Kconfig.series
```kconfig
# Nordic Semiconductor nRF54H MCU line

# Copyright (c) 2024 Nordic Semiconductor ASA
# SPDX-License-Identifier: Apache-2.0

config SOC_SERIES_NRF54HX
	bool "Nordic Semiconductor nRF54H series MCU"
	select ARM
	select ARMV8_M_DSP
	select CPU_CORTEX_M33
	select SOC_FAMILY_NRF
	imply XIP
	select HAS_NRFX
	select HAS_NORDIC_DRIVERS
	select HAS_SEGGER_RTT if ZEPHYR_SEGGER_MODULE
	help
	  Enable support for nRF54H MCU series

if SOC_SERIES_NRF54HX

config SOC_TRIM_HSFLL
	bool
	help
	  SoC HSFLL hardware should be trimmed for accurate clock speeds.

config FICR_HSFLL_TRIM_IDX
	int
	depends on SOC_TRIM_HSFLL
	help
	  Table 1 of the FICR chapter in the Product Specification describes
	  which index of the COARSE and FINE trims must be applied to the domain
	  HSFLL for a given frequency.

	  Refer to nRF54H20 Product Specification > Product configuration >
	  Information configuration registers (ICR) > Peripherals > FICR
	  for more information.

config HSFLL_CLOCK_MULTIPLIER
	int
	depends on SOC_TRIM_HSFLL
	help
	  The HSFLL multiplies the frequency of the input 16 MHz clock
	  by a value stored in CLOCKTRL.MULT register.

endif # SOC_SERIES_NRF54HX
```

## soc/arm/nordic_nrf/nrf54h/Kconfig.soc
```kconfig
# Nordic Semiconductor nRF54H MCU line

# Copyright (c) 2024 Nordic Semiconductor ASA
# SPDX-License-Identifier: Apache-2.0

config SOC_NRF54H20
	bool "nRF54H20"
	depends on SOC_SERIES_NRF54HX

if SOC_NRF54H20

config SOC_NRF54H20_ENG0_CPUAPP
	bool
	select CPU_HAS_ARM_MPU
	select CPU_HAS_ARM_SAU
	select CPU_HAS_DCACHE
	select CPU_HAS_ICACHE
	select CPU_HAS_FPU

config SOC_NRF54H20_ENG0_CPURAD
	bool
	select CPU_HAS_ARM_MPU
	select CPU_HAS_ARM_SAU
	select CPU_HAS_DCACHE
	select CPU_HAS_ICACHE
	select CPU_HAS_FPU

choice
	prompt "nRF54H20 MCU Selection"

config SOC_NRF54H20_ENG0_CPUAPP
	bool "NRF54H20_ENG0_CPUAPP"

config SOC_NRF54H20_ENG0_CPURAD
	bool "NRF54H20_ENG0_CPURAD"

endchoice

config NRF_ENABLE_ICACHE
	bool "Instruction cache (I-Cache)"
	default y

endif # SOC_NRF54H20
```

## tests/drivers/spi/master_slave/boards/nrf52840_pca10056.conf
```kconfig
CONFIG_SPI_1=y
CONFIG_SPI_1_NRF_SPIM=y
CONFIG_SPI_2=y
CONFIG_SPI_2_NRF_SPIS=y

CONFIG_SPI_TEST_MASTER_DRV_NAME="SPI_1"
CONFIG_SPI_TEST_CS_GPIO=y
CONFIG_SPI_TEST_CS_CTRL_GPIO_DRV_NAME="GPIO_0"
CONFIG_SPI_TEST_CS_CTRL_GPIO_PIN=27

CONFIG_SPI_TEST_SLAVE_DRV_NAME="SPI_2"
```

## tests/drivers/spi/master_slave/boards/nrf9160_pca10090.conf
```kconfig
CONFIG_SPI_2=y
CONFIG_SPI_2_NRF_SPIM=y
CONFIG_SPI_3=y
CONFIG_SPI_3_NRF_SPIS=y

CONFIG_SPI_TEST_MASTER_DRV_NAME="SPI_2"
CONFIG_SPI_TEST_CS_GPIO=y
CONFIG_SPI_TEST_CS_CTRL_GPIO_DRV_NAME="GPIO_0"
CONFIG_SPI_TEST_CS_CTRL_GPIO_PIN=13

CONFIG_SPI_TEST_SLAVE_DRV_NAME="SPI_3"
```
