## boards/arm/nrf54h20pdk_nrf54h20/Kconfig.defconfig
```kconfig
# Copyright (c) 2024 Nordic Semiconductor ASA
# SPDX-License-Identifier: Apache-2.0

if BOARD_NRF54H20PDK_NRF54H20_CPUAPP

config BOARD
	default "nrf54h20pdk_nrf54h20_cpuapp"

endif # BOARD_NRF54H20PDK_NRF54H20_CPUAPP

if BOARD_NRF54H20PDK_NRF54H20_CPURAD

config BOARD
	default "nrf54h20pdk_nrf54h20_cpurad"

endif # BOARD_NRF54H20PDK_NRF54H20_CPURAD
```

## boards/arm/nrf54h20pdk_nrf54h20/nrf54h20pdk_nrf54h20_cpurad_defconfig
```kconfig
# Copyright (c) 2024 Nordic Semiconductor ASA
# SPDX-License-Identifier: Apache-2.0

CONFIG_SOC_SERIES_NRF54HX=y
CONFIG_SOC_NRF54H20=y
CONFIG_SOC_NRF54H20_ENG0_CPURAD=y
CONFIG_BOARD_NRF54H20PDK_NRF54H20_CPURAD=y

CONFIG_USE_DT_CODE_PARTITION=y

# Enable MPU
CONFIG_ARM_MPU=y

# Enable hardware stack protection
CONFIG_HW_STACK_PROTECTION=y

# Enable cache
CONFIG_CACHE_MANAGEMENT=y
CONFIG_EXTERNAL_CACHE=y
CONFIG_DCACHE=n

CONFIG_NULL_POINTER_EXCEPTION_DETECTION_NONE=y
```

## drivers/cache/Kconfig.nrfx
```kconfig
# Copyright (c) 2024 Carlo Caione <ccaione@baylibre.com>
# SPDX-License-Identifier: Apache-2.0

config CACHE_NRFX_CACHE
	bool "NRFX cache driver"
	select CACHE_HAS_DRIVER
	depends on HAS_NRFX && CACHE_MANAGEMENT
	help
	  Enable support for the NRFX cache driver.
```

## drivers/pwm/Kconfig.nrfx
```kconfig
# Copyright (c) 2018, Cue Health Inc
# SPDX-License-Identifier: Apache-2.0

config PWM_NRFX
	bool "nRF PWM nrfx driver"
	default y
	depends on $(dt_compat_enabled,$(DT_COMPAT_NORDIC_NRF_PWM))
	select NRFX_PWM0 if "$(dt_nodelabel_enabled,pwm0)"
	select NRFX_PWM1 if "$(dt_nodelabel_enabled,pwm1)"
	select NRFX_PWM2 if "$(dt_nodelabel_enabled,pwm2)"
	select NRFX_PWM3 if "$(dt_nodelabel_enabled,pwm3)"
	help
	  Enable support for nrfx Hardware PWM driver for nRF52 MCU series.
```

## drivers/sensor/nrf5/Kconfig
```kconfig
# nRF5 temperature sensor configuration options

# Copyright (c) 2016 ARM Ltd.
# SPDX-License-Identifier: Apache-2.0

config TEMP_NRF5
	bool "nRF5 Temperature Sensor"
	depends on $(dt_nodelabel_has_compat,temp,$(DT_COMPAT_NORDIC_NRF_TEMP))
	help
	  Enable driver for nRF5 temperature sensor.
```

## dts/bindings/cpu/nordic,riscv.yaml
```yaml
# Copyright (c) 2024 Nordic Semiconductor ASA
# SPDX-License-Identifier: Apache-2.0

description: Nordic Semiconductor RISC-V CPU

compatible: "nordic,riscv"

include: riscv,cpus.yaml
```

## dts/bindings/gpio/nxp,pcal6408a.yaml
```yaml
# Copyright (c) 2021 Nordic Semiconductor ASA
# SPDX-License-Identifier: Apache-2.0

description: PCAL6408A GPIO node

compatible: "nxp,pcal6408a"

include: [i2c-device.yaml, gpio-controller.yaml]

properties:
    label:
      required: true

    ngpios:
      required: true
      const: 8

    nint-gpios:
      type: phandle-array
      required: false
      description: |
        Connection for the NINT signal. This signal is active-low when
        produced by pcal6408a GPIO node.

    init-out-low:
      type: int
      required: false
      default: 0
      description: |
        Bit mask identifying pins that should be initialized as outputs
        driven low.

    init-out-high:
      type: int
      required: false
      default: 0
      description: |
        Bit mask identifying pins that should be initialized as outputs
        driven high.

    "#gpio-cells":
      const: 2

gpio-cells:
  - pin
  - flags
```

## dts/bindings/riscv/nordic,vpr-coprocessor.yaml
```yaml
# Copyright (c) 2024 Nordic Semiconductor ASA
# SPDX-License-Identifier: Apache-2.0

compatible: "nordic,vpr-coprocessor"

description: |
  VPR coprocessor

  VPR is a RISC-V CPU implementation. VPR instances are exposed to other CPUs as
  peripherals. A domain can take ownership of one or more VPRs.

include: base.yaml

properties:
  cpu:
    type: int
    required: true
    description: |
      Processor ID of the VPR core.

  loader-img-dst:
    type: phandle
    required: true
    description: |
      Destination memory handle. Points to the area from which the VPR core
      will start execution.

  loader-img-src:
    type: phandle
    description: |
      Source memory handle. If specified, then the VPR's firmware image will be
      relocated from this location to the one given by "loader-img-dst".
```

## dts/bindings/serial/nordic,nrf-uart-common.yaml
```yaml
include: uart-controller.yaml

properties:
    reg:
      required: true

    interrupts:
      required: true

    tx-gpios:
      type: phandle-array
      required: false
      description: |
        The TX pin to use. The value is "<&gpioX Y flags>".
        Pin PX.Y will be used for TX. The "flags" portion currently
        has no effect, but must be set to zero.

        For example, to use P0.16 for TX, set:

          tx-gpios = <&gpio0 16 0>;

        To use P1.2 for TX, set:

          tx-gpios = <&gpio1 2 0>;

    rx-gpios:
      type: phandle-array
      required: false
      description: |
        The RX pin to use. The value should be set in the same
        way as the tx-gpios property.

    rts-gpios:
      type: phandle-array
      required: false
      description: |
        The RTS pin to use. The value should be set in the same
        way as the tx-gpios property.

    cts-gpios:
      type: phandle-array
      required: false
      description: |
        The CTS pin to use. The value should be set in the same
        way as the tx-gpios property.

    tx-pin:
      type: int
      deprecated: true
      description: |
        Deprecated; use tx-gpios instead.

        The TX pin to use.

        For pins P0.0 through P0.31, use the pin number. For example,
        to use P0.16 for TX, set:

            tx-pin = <16>;

        For pins P1.0 through P1.31, add 32 to the pin number. For
        example, to use P1.2 for TX, set:

            tx-pin = <34>;  /* 32 + 2 */

    rx-pin:
      type: int
      deprecated: true
      description: |
        Deprecated; use rx-gpios instead.

        The RX pin to use. The pin numbering scheme is the same as the
        tx-pin property's.

    rts-pin:
      type: int
      deprecated: true
      description: |
        Deprecated; use rts-gpios instead.

        The RTS pin to use. The pin numbering scheme is the same as the
        tx-pin property's.

    cts-pin:
      type: int
      deprecated: true
      description: |
        Deprecated; use cts-gpios instead.

        The CTS pin to use. The pin numbering scheme is the same as the
        tx-pin property's.

    current-speed:
      description: |
        Initial baud rate setting for UART. Only a fixed set of baud
        rates are selectable on these devices.
      enum:
        - 1200
        - 2400
        - 4800
        - 9600
        - 14400
        - 19200
        - 28800
        - 31250
        - 38400
        - 56000
        - 57600
        - 76800
        - 115200
        - 230400
        - 250000
        - 460800
        - 921600
        - 1000000
```
