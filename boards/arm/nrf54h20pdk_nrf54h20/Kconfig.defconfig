## modules/Kconfig.nordic
```kconfig
# Copyright (c) 2016 Nordic Semiconductor ASA
# SPDX-License-Identifier: Apache-2.0

# Workaround for not being able to have commas in macro arguments
DT_COMPAT_NORDIC_NRF_ADC    := nordic,nrf-adc
DT_COMPAT_NORDIC_NRF_CLOCK  := nordic,nrf-clock
DT_COMPAT_NORDIC_NRF_COMP   := nordic,nrf-comp
DT_COMPAT_NORDIC_NRF_EGU    := nordic,nrf-egu
DT_COMPAT_NORDIC_NRF_PWM    := nordic,nrf-pwm
DT_COMPAT_NORDIC_NRF_RTC    := nordic,nrf-rtc
DT_COMPAT_NORDIC_NRF_RNG    := nordic,nrf-rng
DT_COMPAT_NORDIC_NRF_SAADC  := nordic,nrf-saadc
DT_COMPAT_NORDIC_NRF_SPI    := nordic,nrf-spi
DT_COMPAT_NORDIC_NRF_SPIM   := nordic,nrf-spim
DT_COMPAT_NORDIC_NRF_SPIS   := nordic,nrf-spis
DT_COMPAT_NORDIC_NRF_TEMP   := nordic,nrf-temp
DT_COMPAT_NORDIC_NRF_TIMER  := nordic,nrf-timer
DT_COMPAT_NORDIC_NRF_TWI    := nordic,nrf-twi
DT_COMPAT_NORDIC_NRF_TWIM   := nordic,nrf-twim
DT_COMPAT_NORDIC_NRF_TWIS   := nordic,nrf-twis
DT_COMPAT_NORDIC_NRF_UART   := nordic,nrf-uart
DT_COMPAT_NORDIC_NRF_UARTE  := nordic,nrf-uarte
DT_COMPAT_NORDIC_NRF_USBD   := nordic,nrf-usbd
DT_COMPAT_NORDIC_NRF_USBREG := nordic,nrf-usbreg
DT_COMPAT_NORDIC_NRF_WDT    := nordic,nrf-wdt

config HAS_NORDIC_DRIVERS
	bool
	default y if HAS_HW_NRF_RADIO_IEEE802154

menu "Nordic drivers"
	depends on HAS_NORDIC_DRIVERS

menuconfig NRF_802154_RADIO_DRIVER
	bool "Enable nRF IEEE 802.15.4 radio driver"
	depends on HAS_HW_NRF_RADIO_IEEE802154
	help
	  This option enables nRF IEEE 802.15.4 radio driver in Zephyr. Note,
	  that beside the radio peripheral itself, this drivers occupies several
	  other peripherals. A complete list can be found in the hal_nordic
	  repository, within drivers/nrf_radio_802154/nrf_802154_peripherals.h
	  file.

if NRF_802154_RADIO_DRIVER

choice NRF_802154_CCA_MODE
	prompt "nRF IEEE 802.15.4 CCA mode"
	default NRF_802154_CCA_MODE_ED
	help
	  CCA mode

config NRF_802154_CCA_MODE_ED
	bool "Energy Above Threshold"

config NRF_802154_CCA_MODE_CARRIER
	bool "Carrier Seen"

config NRF_802154_CCA_MODE_CARRIER_AND_ED
	bool "Energy Above Threshold AND Carrier Seen"

config NRF_802154_CCA_MODE_CARRIER_OR_ED
	bool "Energy Above Threshold OR Carrier Seen"

endchoice

config NRF_802154_CCA_ED_THRESHOLD
	int "nRF IEEE 802.15.4 CCA Energy Detection threshold"
	default 45
	help
	  If energy detected in a given channel is above the value then the
	  channel is deemed busy. The unit is defined as per 802.15.4-2006 spec.

config NRF_802154_CCA_CORR_THRESHOLD
	int "nRF IEEE 802.15.4 CCA Correlator threshold"
	default 45

config NRF_802154_CCA_CORR_LIMIT
	int "nRF IEEE 802.15.4 CCA Correlator limit"
	default 2
	help
	  Limit for occurrences above correlator threshold. When not equal to
	  zero the correlator based signal detect is enabled.

endif # NRF_802154_RADIO_DRIVER

endmenu

config HAS_NRFX
	bool
	select HAS_CMSIS_CORE

menu "nrfx drivers"
	depends on HAS_NRFX

config NRFX_ADC
	bool "Enable ADC driver"
	depends on $(dt_compat_enabled,$(DT_COMPAT_NORDIC_NRF_ADC))

config NRFX_CLOCK
	bool "Enable CLOCK driver"
	depends on $(dt_compat_enabled,$(DT_COMPAT_NORDIC_NRF_CLOCK))

config NRFX_COMP
	bool "Enable COMP driver"
	depends on $(dt_compat_enabled,$(DT_COMPAT_NORDIC_NRF_COMP))

config NRFX_DPPI
	bool "Enable DPPI allocator"
	depends on HAS_HW_NRF_DPPIC

config NRFX_EGU
	bool "Enable EGU driver"
	depends on $(dt_compat_enabled,$(DT_COMPAT_NORDIC_NRF_EGU))

config NRFX_EGU0
	bool "Enable EGU0 instance"
	depends on $(dt_nodelabel_has_compat,egu0,$(DT_COMPAT_NORDIC_NRF_EGU))
	select NRFX_EGU

config NRFX_EGU1
	bool "Enable EGU1 instance"
	depends on $(dt_nodelabel_has_compat,egu1,$(DT_COMPAT_NORDIC_NRF_EGU))
	select NRFX_EGU

config NRFX_EGU2
	bool "Enable EGU2 instance"
	depends on $(dt_nodelabel_has_compat,egu2,$(DT_COMPAT_NORDIC_NRF_EGU))
	select NRFX_EGU

config NRFX_EGU3
	bool "Enable EGU3 instance"
	depends on $(dt_nodelabel_has_compat,egu3,$(DT_COMPAT_NORDIC_NRF_EGU))
	select NRFX_EGU

config NRFX_EGU4
	bool "Enable EGU4 instance"
	depends on $(dt_nodelabel_has_compat,egu4,$(DT_COMPAT_NORDIC_NRF_EGU))
	select NRFX_EGU

config NRFX_EGU5
	bool "Enable EGU5 instance"
	depends on $(dt_nodelabel_has_compat,egu5,$(DT_COMPAT_NORDIC_NRF_EGU))
	select NRFX_EGU

config NRFX_GPIOTE
	bool "Enable GPIOTE driver"
	depends on HAS_HW_NRF_GPIOTE

config NRFX_I2S
	bool "Enable I2S driver"
	depends on HAS_HW_NRF_I2S

config NRFX_IPC
	bool "Enable IPC driver"
	depends on HAS_HW_NRF_IPC

config NRFX_LPCOMP
	bool "Enable LPCOMP driver"
	depends on HAS_HW_NRF_LPCOMP

config NRFX_NFCT
	bool "Enable NFCT driver"
	depends on HAS_HW_NRF_NFCT
	select NRFX_TIMER4 if SOC_SERIES_NRF52X
	select NRFX_TIMER2 if SOC_SERIES_NRF53X

config NRFX_NVMC
	bool "Enable NVMC driver"

config NRFX_PDM
	bool "Enable PDM driver"
	depends on HAS_HW_NRF_PDM

config NRFX_POWER
	bool "Enable POWER driver"
	depends on HAS_HW_NRF_POWER

config NRFX_PPI
	bool "Enable PPI allocator"
	depends on HAS_HW_NRF_PPI

config NRFX_PWM
	bool "Enable PWM driver"
	depends on $(dt_compat_enabled,$(DT_COMPAT_NORDIC_NRF_PWM))

config NRFX_PWM0
	bool "Enable PWM0 instance"
	depends on $(dt_nodelabel_has_compat,pwm0,$(DT_COMPAT_NORDIC_NRF_PWM))
	select NRFX_PWM

config NRFX_PWM1
	bool "Enable PWM1 instance"
	depends on $(dt_nodelabel_has_compat,pwm1,$(DT_COMPAT_NORDIC_NRF_PWM))
	select NRFX_PWM

config NRFX_PWM2
	bool "Enable PWM2 instance"
	depends on $(dt_nodelabel_has_compat,pwm2,$(DT_COMPAT_NORDIC_NRF_PWM))
	select NRFX_PWM

config NRFX_PWM3
	bool "Enable PWM3 instance"
	depends on $(dt_nodelabel_has_compat,pwm3,$(DT_COMPAT_NORDIC_NRF_PWM))
	select NRFX_PWM

config NRFX_QDEC
	bool "Enable QDEC driver"
	depends on HAS_HW_NRF_QDEC

config NRFX_QSPI
	bool "Enable QSPI driver"
	depends on HAS_HW_NRF_QSPI

config NRFX_RNG
	bool "Enable RNG driver"
	depends on $(dt_compat_enabled,$(DT_COMPAT_NORDIC_NRF_RNG))

config NRFX_RTC
	bool "Enable RTC driver"
	depends on $(dt_compat_enabled,$(DT_COMPAT_NORDIC_NRF_RTC))

config NRFX_RTC0
	bool "Enable RTC0 instance"
	depends on $(dt_nodelabel_has_compat,rtc0,$(DT_COMPAT_NORDIC_NRF_RTC))
	select NRFX_RTC

config NRFX_RTC1
	bool "Enable RTC1 instance"
	depends on $(dt_nodelabel_has_compat,rtc1,$(DT_COMPAT_NORDIC_NRF_RTC))
	select NRFX_RTC

config NRFX_RTC2
	bool "Enable RTC2 instance"
	depends on $(dt_nodelabel_has_compat,rtc2,$(DT_COMPAT_NORDIC_NRF_RTC))
	select NRFX_RTC

config NRFX_SAADC
	bool "Enable SAADC driver"
	depends on $(dt_compat_enabled,$(DT_COMPAT_NORDIC_NRF_SAADC))

config NRFX_SPI
	bool "Enable SPI driver"
	depends on $(dt_compat_enabled,$(DT_COMPAT_NORDIC_NRF_SPI))

config NRFX_SPI0
	bool "Enable SPI0 instance"
	depends on $(dt_nodelabel_has_compat,spi0,$(DT_COMPAT_NORDIC_NRF_SPI))
	select NRFX_SPI

config NRFX_SPI1
	bool "Enable SPI1 instance"
	depends on $(dt_nodelabel_has_compat,spi1,$(DT_COMPAT_NORDIC_NRF_SPI))
	select NRFX_SPI

config NRFX_SPI2
	bool "Enable SPI2 instance"
	depends on $(dt_nodelabel_has_compat,spi2,$(DT_COMPAT_NORDIC_NRF_SPI))
	select NRFX_SPI

config NRFX_SPIM
	bool "Enable SPIM driver"
	depends on $(dt_compat_enabled,$(DT_COMPAT_NORDIC_NRF_SPIM))

config NRFX_SPIM0
	bool "Enable SPIM0 instance"
	depends on $(dt_nodelabel_has_compat,spi0,$(DT_COMPAT_NORDIC_NRF_SPIM))
	select NRFX_SPIM

config NRFX_SPIM1
	bool "Enable SPIM1 instance"
	depends on $(dt_nodelabel_has_compat,spi1,$(DT_COMPAT_NORDIC_NRF_SPIM))
	select NRFX_SPIM

config NRFX_SPIM2
	bool "Enable SPIM2 instance"
	depends on $(dt_nodelabel_has_compat,spi2,$(DT_COMPAT_NORDIC_NRF_SPIM))
	select NRFX_SPIM

config NRFX_SPIM3
	bool "Enable SPIM3 instance"
	depends on $(dt_nodelabel_has_compat,spi3,$(DT_COMPAT_NORDIC_NRF_SPIM))
	select NRFX_SPIM

config NRFX_SPIM4
	bool "Enable SPIM4 instance"
	depends on $(dt_nodelabel_has_compat,spi4,$(DT_COMPAT_NORDIC_NRF_SPIM))
	select NRFX_SPIM

config NRFX_SPIS
	bool "Enable SPIS driver"
	depends on $(dt_compat_enabled,$(DT_COMPAT_NORDIC_NRF_SPIS))

config NRFX_SPIS0
	bool "Enable SPIS0 instance"
	depends on $(dt_nodelabel_has_compat,spi0,$(DT_COMPAT_NORDIC_NRF_SPIS))
	select NRFX_SPIS

config NRFX_SPIS1
	bool "Enable SPIS1 instance"
	depends on $(dt_nodelabel_has_compat,spi1,$(DT_COMPAT_NORDIC_NRF_SPIS))
	select NRFX_SPIS

config NRFX_SPIS2
	bool "Enable SPIS2 instance"
	depends on $(dt_nodelabel_has_compat,spi2,$(DT_COMPAT_NORDIC_NRF_SPIS))
	select NRFX_SPIS

config NRFX_SPIS3
	bool "Enable SPIS3 instance"
	depends on $(dt_nodelabel_has_compat,spi3,$(DT_COMPAT_NORDIC_NRF_SPIS))
	select NRFX_SPIS

config NRFX_SYSTICK
	bool "Enable SYSTICK driver"
	depends on CPU_CORTEX_M_HAS_SYSTICK

config NRFX_TEMP
	bool "Enable TEMP driver"
	depends on $(dt_compat_enabled,$(DT_COMPAT_NORDIC_NRF_TEMP))

config NRFX_TIMER
	bool "Enable TIMER driver"
	depends on $(dt_compat_enabled,$(DT_COMPAT_NORDIC_NRF_TIMER))

config NRFX_TIMER0
	bool "Enable TIMER0 instance"
	depends on $(dt_nodelabel_has_compat,timer0,$(DT_COMPAT_NORDIC_NRF_TIMER))
	select NRFX_TIMER

config NRFX_TIMER1
	bool "Enable TIMER1 instance"
	depends on $(dt_nodelabel_has_compat,timer1,$(DT_COMPAT_NORDIC_NRF_TIMER))
	select NRFX_TIMER

config NRFX_TIMER2
	bool "Enable TIMER2 instance"
	depends on $(dt_nodelabel_has_compat,timer2,$(DT_COMPAT_NORDIC_NRF_TIMER))
	select NRFX_TIMER

config NRFX_TIMER3
	bool "Enable TIMER3 instance"
	depends on $(dt_nodelabel_has_compat,timer3,$(DT_COMPAT_NORDIC_NRF_TIMER))
	select NRFX_TIMER

config NRFX_TIMER4
	bool "Enable TIMER4 instance"
	depends on $(dt_nodelabel_has_compat,timer4,$(DT_COMPAT_NORDIC_NRF_TIMER))
	select NRFX_TIMER

config NRFX_TWI
	bool "Enable TWI driver"
	depends on $(dt_compat_enabled,$(DT_COMPAT_NORDIC_NRF_TWI))

config NRFX_TWI0
	bool "Enable TWI0 instance"
	depends on $(dt_nodelabel_has_compat,i2c0,$(DT_COMPAT_NORDIC_NRF_TWI))
	select NRFX_TWI

config NRFX_TWI1
	bool "Enable TWI1 instance"
	depends on $(dt_nodelabel_has_compat,i2c1,$(DT_COMPAT_NORDIC_NRF_TWI))
	select NRFX_TWI

config NRFX_TWIM
	bool "Enable TWIM driver"
	depends on $(dt_compat_enabled,$(DT_COMPAT_NORDIC_NRF_TWIM))

config NRFX_TWIM0
	bool "Enable TWIM0 instance"
	depends on $(dt_nodelabel_has_compat,i2c0,$(DT_COMPAT_NORDIC_NRF_TWIM))
	select NRFX_TWIM

config NRFX_TWIM1
	bool "Enable TWIM1 instance"
	depends on $(dt_nodelabel_has_compat,i2c1,$(DT_COMPAT_NORDIC_NRF_TWIM))
	select NRFX_TWIM

config NRFX_TWIM2
	bool "Enable TWIM2 instance"
	depends on $(dt_nodelabel_has_compat,i2c2,$(DT_COMPAT_NORDIC_NRF_TWIM))
	select NRFX_TWIM

config NRFX_TWIM3
	bool "Enable TWIM3 instance"
	depends on $(dt_nodelabel_has_compat,i2c3,$(DT_COMPAT_NORDIC_NRF_TWIM))
	select NRFX_TWIM

config NRFX_TWIS
	bool "Enable TWIS driver"
	depends on $(dt_compat_enabled,$(DT_COMPAT_NORDIC_NRF_TWIS))

config NRFX_TWIS0
	bool "Enable TWIS0 instance"
	depends on $(dt_nodelabel_has_compat,i2c0,$(DT_COMPAT_NORDIC_NRF_TWIS))
	select NRFX_TWIS

config NRFX_TWIS1
	bool "Enable TWIS1 instance"
	depends on $(dt_nodelabel_has_compat,i2c1,$(DT_COMPAT_NORDIC_NRF_TWIS))
	select NRFX_TWIS

config NRFX_TWIS2
	bool "Enable TWIS2 instance"
	depends on $(dt_nodelabel_has_compat,i2c2,$(DT_COMPAT_NORDIC_NRF_TWIS))
	select NRFX_TWIS

config NRFX_TWIS3
	bool "Enable TWIS3 instance"
	depends on $(dt_nodelabel_has_compat,i2c3,$(DT_COMPAT_NORDIC_NRF_TWIS))
	select NRFX_TWIS

config NRFX_UART
	bool "Enable UART driver"
	depends on $(dt_compat_enabled,$(DT_COMPAT_NORDIC_NRF_UART))

config NRFX_UART0
	bool "Enable UART0 instance"
	depends on $(dt_nodelabel_has_compat,uart0,$(DT_COMPAT_NORDIC_NRF_UART))
	select NRFX_UART

config NRFX_UARTE
	bool "Enable UARTE driver"
	depends on $(dt_compat_enabled,$(DT_COMPAT_NORDIC_NRF_UARTE))

config NRFX_UARTE0
	bool "Enable UARTE0 instance"
	depends on $(dt_nodelabel_has_compat,uart0,$(DT_COMPAT_NORDIC_NRF_UARTE))
	select NRFX_UARTE

config NRFX_UARTE1
	bool "Enable UARTE1 instance"
	depends on $(dt_nodelabel_has_compat,uart1,$(DT_COMPAT_NORDIC_NRF_UARTE))
	select NRFX_UARTE

config NRFX_UARTE2
	bool "Enable UARTE2 instance"
	depends on $(dt_nodelabel_has_compat,uart2,$(DT_COMPAT_NORDIC_NRF_UARTE))
	select NRFX_UARTE

config NRFX_UARTE3
	bool "Enable UARTE3 instance"
	depends on $(dt_nodelabel_has_compat,uart3,$(DT_COMPAT_NORDIC_NRF_UARTE))
	select NRFX_UARTE

config NRFX_USBD
	bool "Enable USBD driver"
	depends on $(dt_compat_enabled,$(DT_COMPAT_NORDIC_NRF_USBD))
	select NRFX_SYSTICK

config NRFX_USBREG
	bool "Enable USBREG driver"
	depends on $(dt_compat_enabled,$(DT_COMPAT_NORDIC_NRF_USBREG))

config NRFX_WDT
	bool "Enable WDT driver"
	depends on $(dt_compat_enabled,$(DT_COMPAT_NORDIC_NRF_WDT))

config NRFX_WDT0
	bool "Enable WDT0 instance"
	depends on $(dt_nodelabel_has_compat,wdt0,$(DT_COMPAT_NORDIC_NRF_WDT))
	select NRFX_WDT

config NRFX_WDT1
	bool "Enable WDT1 instance"
	depends on $(dt_nodelabel_has_compat,wdt1,$(DT_COMPAT_NORDIC_NRF_WDT))
	select NRFX_WDT

config NRFX_PRS
	bool "Enable Peripheral Resource Sharing module"

config NRFX_PRS_BOX_0
	bool "Enable PRS box 0"
	select NRFX_PRS

config NRFX_PRS_BOX_1
	bool "Enable PRS box 1"
	select NRFX_PRS

config NRFX_PRS_BOX_2
	bool "Enable PRS box 2"
	select NRFX_PRS

config NRFX_PRS_BOX_3
	bool "Enable PRS box 3"
	select NRFX_PRS

config NRFX_PRS_BOX_4
	bool "Enable PRS box 4"
	select NRFX_PRS

endmenu
```

## soc/arm/nordic_nrf/Kconfig.peripherals
```kconfig
# Nordic Semiconductor nRFx MCU peripherals list.

# Copyright (c) 2018 Nordic Semiconductor ASA
# SPDX-License-Identifier: Apache-2.0

config HAS_HW_NRF_DPPIC
	bool

config HAS_HW_NRF_ECB
	bool

config HAS_HW_NRF_GPIO0
	bool

config HAS_HW_NRF_GPIO1
	bool

config HAS_HW_NRF_GPIOTE
	bool

config HAS_HW_NRF_I2S
	bool

config HAS_HW_NRF_IPC
	bool

config HAS_HW_NRF_LPCOMP
	bool

config HAS_HW_NRF_MPU
	bool

config HAS_HW_NRF_MWU
	bool

config HAS_HW_NRF_NFCT
	bool

# NVMC supports partial erase
config HAS_HW_NRF_NVMC_PE
	bool

config HAS_HW_NRF_PDM
	bool

config HAS_HW_NRF_POWER
	bool

config HAS_HW_NRF_PPI
	bool

config HAS_HW_NRF_QDEC
	bool

config HAS_HW_NRF_QSPI
	bool

config HAS_HW_NRF_RADIO_BLE_CODED
	bool

config HAS_HW_NRF_RADIO_IEEE802154
	bool

config HAS_HW_NRF_SPU
	bool

config HAS_HW_NRF_SWI0
	bool

config HAS_HW_NRF_SWI1
	bool

config HAS_HW_NRF_SWI2
	bool

config HAS_HW_NRF_SWI3
	bool

config HAS_HW_NRF_SWI4
	bool

config HAS_HW_NRF_SWI5
	bool
```

## soc/arm/nordic_nrf/nrf54h/Kconfig.defconfig.nrf54h20_cpuapp
```kconfig
# Nordic Semiconductor nRF54H20 Application MCU

# Copyright (c) 2024 Nordic Semiconductor ASA
# SPDX-License-Identifier: Apache-2.0

if SOC_NRF54H20_ENG0_CPUAPP

config SOC
	default "nRF54H20_CPUAPP"

config NUM_IRQS
	default 471

endif # SOC_NRF54H20_ENG0_CPUAPP
```

## soc/arm/nordic_nrf/nrf54h/Kconfig.defconfig.nrf54h20_cpurad
```kconfig
# Nordic Semiconductor nRF54H20 Radio MCU

# Copyright (c) 2024 Nordic Semiconductor ASA
# SPDX-License-Identifier: Apache-2.0

if SOC_NRF54H20_ENG0_CPURAD

config SOC
	default "nRF54H20_CPURAD"

config NUM_IRQS
	default 471

config SOC_TRIM_HSFLL
	default y

config FICR_HSFLL_TRIM_IDX
	# CPURAD operates at 256 MHz
	default 1

config HSFLL_CLOCK_MULTIPLIER
	default 16

endif # SOC_NRF54H20_ENG0_CPURAD
```
