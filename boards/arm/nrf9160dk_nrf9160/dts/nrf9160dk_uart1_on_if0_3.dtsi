/*
 * Copyright (c) 2021 Nordic Semiconductor ASA
 *
 * SPDX-License-Identifier: Apache-2.0
 */

&uart1 {
	status = "okay";
	tx-pin = <&interface_to_nrf52840 1 0>;
	rx-pin = <&interface_to_nrf52840 0 0>;
	rts-pin = <&interface_to_nrf52840 3 0>;
	cts-pin = <&interface_to_nrf52840 2 0>;
};
