/*
 * Copyright (c) 2021 Nordic Semiconductor ASA
 *
 * SPDX-License-Identifier: Apache-2.0
 */

&nrf_interface_pins_0_2_routing {
	status = "okay";
};

&nrf_interface_pins_3_5_routing {
	status = "okay";
};

&uart1 {
	status = "okay";
	tx-pin = <&interface_to_nrf9160 0 0>;
	rx-pin = <&interface_to_nrf9160 1 0>;
	rts-pin = <&interface_to_nrf9160 2 0>;
	cts-pin = <&interface_to_nrf9160 3 0>;
};
