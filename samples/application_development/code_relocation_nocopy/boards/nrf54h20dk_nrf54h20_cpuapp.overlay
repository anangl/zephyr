&cpuapp_ram0x_region {
	nordic,access = <NRF_OWNER_ID_APPLICATION NRF_PERM_RWXS>;
};

&xip_region {
	status = "okay";
	nordic,access = <NRF_OWNER_ID_APPLICATION NRF_PERM_RWX>;
};

&mx25uw63 {
	read-command = <0xEC13>;
	write-command = <0x12ED>;
	command-length = "INSTR_2_BYTE";
	address-length = "ADDR_4_BYTE";
	rx-dummy = <20>;
	tx-dummy = <0>;

	xip-config = <1 0 0x1000 0>;
};
